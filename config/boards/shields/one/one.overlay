/ {
    chosen {
        zmk,kscan = &default_kscan;
    };

    default_kscan: kscan {
        compatible = "zmk,kscan-gpio-direct";
        label = "default_kscan";

        input-gpios =
            <&xiao_d 1 (GPIO_ACTIVE_LOW  | GPIO_PULL_UP)>
        ;
    };
};
